## board/myir/myd_yf13x/Kconfig
```kconfig
if TARGET_MYIR_MYD_YF13X

config SYS_BOARD
	default "myd_yf13x"

config SYS_VENDOR
	default "myir"

config SYS_CONFIG_NAME
	default "myd_yf13x"

config MYIR_512N512D
	bool "MYIR 512N512D board variant"
	depends on MTD_SPI_NAND
	default n
	help
	  Enable board-specific behavior for the MYIR 512N512D NAND variant.

source "board/myir/common/Kconfig"
endif

if TARGET_ST_STM32MP13X

config SYS_BOARD
	default "stm32mp1"

config SYS_VENDOR
	default "st"

config SYS_CONFIG_NAME
	default "stm32mp13_st_common"

source "board/st/common/Kconfig"

endif
```
