## board/myir/myd-ld25x/Kconfig
```kconfig
if TARGET_MYIR_MYD_LD25X

config SYS_BOARD
	default "myd_ld25x"

config SYS_VENDOR
	default "myir"

config SYS_CONFIG_NAME
	default "myd_ld25x"

source "board/myir/common/Kconfig"
endif

if TARGET_ST_STM32MP23X

config SYS_BOARD
	default "stm32mp2"

config SYS_VENDOR
	default "st"

config SYS_CONFIG_NAME
	default "stm32mp23_st_common"

source "board/st/common/Kconfig"
endif

if TARGET_ST_STM32MP21X

config SYS_BOARD
	default "stm32mp2"

config SYS_VENDOR
	default "st"

config SYS_CONFIG_NAME
	default "stm32mp21_st_common"

source "board/st/common/Kconfig"
endif
```

## board/myir/myd_ld25x/Kconfig
```kconfig
if TARGET_MYIR_MYD_LD25X

config SYS_BOARD
	default "myd_ld25x"

config SYS_VENDOR
	default "myir"

config SYS_CONFIG_NAME
	default "myd_ld25x"

source "board/myir/common/Kconfig"
endif
```
